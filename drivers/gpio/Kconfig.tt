## drivers/gpio/Kconfig.tt
```kconfig
# Copyright (c) 2025 Tenstorrent AI ALU
# SPDX-License-Identifier: Apache-2.0

config GPIO_TT
    bool "Tenstorrent GPIO"
    default y
    depends onb DT_HAS_ZEPHYR_GPIO_TT_ENABLED
    help
        Enable the Tenstorrent GPIO driver.
```

## dts/bindings/misc/zephyr,gpio-tt.yaml
```yaml
# Copyright (c) 2025 Tenstorrent AI ULC
# SPDX-License-Identifier: Apache-2.0

description: GPIO TT

compatible: "zephyr,gpio-tt"

include: [gpio-controller.yaml, base.yaml]

properties:
  reg:
    required: true

  nggpios:
    type: int
    required: true

  port-index:
    type: int
    required: true

  "#gpio-cells":
    const: 2

gpio-cells:
  - pin
  - flags
```
